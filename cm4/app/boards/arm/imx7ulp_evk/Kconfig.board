## cm4/app/boards/arm/imx7ulp_evk/Kconfig.board
```kconfig
config BOARD_NXP_IMX7ULP_EVK
    bool "NXP iMX.7ULP EVK"
    depends on SOC_MCIMX7ULP_M4
    select SOC_PART_NUMBER_MCIMX7U5DVP08SC
```

## cm4/app/boards/arm/imx7ulp_evk/Kconfig.defconfig
```kconfig
if BOARD_NXP_IMX7ULP_EVK

config BOARD
    default "imx7ulp_evk"

if !XIP
config FLASH_SIZE
    default 0
config FLASH_BASE_ADDRESS
    default 0
endif    # !XIP

endif    # BOARD_NXP_IMX7ULP_EVK
```

## cm4/app/boards/arm/imx7ulp_evk/imx7ulp_evk_defconfig
```kconfig
CONFIG_SOC_MCIMX7ULP_M4=y
CONFIG_UART_CONSOLE=y
CONFIG_SERIAL=y
CONFIG_UART_INTERRUPT_DRIVEN=y
CONFIG_CONSOLE=y
CONFIG_XIP=n
CONFIG_PINCTRL=y
```

## cm4/app/soc/arm/mcimx7ulp_m4/Kconfig.soc
```kconfig
# iMX7 M4 core series

# Copyright (c) 2017, NXP
# SPDX-License-Identifier: Apache-2.0

choice
	prompt "i.MX7 M4 Selection"

config SOC_MCIMX7ULP_M4
	bool "SOC_MCIMX7ULP_M4"
	select HAS_IMX_HAL
	select HAS_IMX_GPIO
	select HAS_IMX_I2C
	select HAS_IMX_IOMUXC

endchoice

if SOC_MCIMX7ULP_M4

config SOC_PART_NUMBER_MCIMX7U5DVP08SC
	bool

config SOC_PART_NUMBER_IMX7ULP_M4
	string
    default	"MCIMX7U5DVP08SC" if SOC_PART_NUMBER_MCIMX7U5DVP08SC
	help
	  This string holds the full part number of the SoC. It is a hidden option
	  that you should not set directly. The part number selection choice defines
	  the default value for this string.

endif # SOC_MCIMX7ULP_M4
```
